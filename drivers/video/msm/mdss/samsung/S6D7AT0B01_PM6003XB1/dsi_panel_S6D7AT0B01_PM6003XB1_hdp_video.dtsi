/* Copyright (c) 2013-14, Samsung Electronics Corporation. All rights reserved.
 *
 * This program is free software; you can redistribute it and/or modify
 * it under the terms of the GNU General Public License version 2 and
 * only version 2 as published by the Free Software Foundation.
 *
 * This program is distributed in the hope that it will be useful,
 * but WITHOUT ANY WARRANTY; without even the implied warranty of
 * MERCHANTABILITY or FITNESS FOR A PARTICULAR PURPOSE.  See the
 * GNU General Public License for more details.
 */

/*---------------------------------------------------------------------------
 * This file is autogenerated file using gcdb parser. Please do not edit it.
 * Update input XML file to add a new entry or update variable in this file
 * VERSION = "1.0"
 *---------------------------------------------------------------------------*/
&mdss_mdp {
	ss_dsi_panel_S6D7AT0B01_PM6003XB1_HDP: ss_dsi_panel_S6D7AT0B01_PM6003XB1_HDP {
		qcom,mdss-dsi-panel-name = "ss_dsi_panel_S6D7AT0B01_PM6003XB1_HDP";
		qcom,mdss-dsi-panel-controller = <&mdss_dsi0>;
		qcom,mdss-dsi-panel-width = <720>;
		qcom,mdss-dsi-panel-height = <1480>;
		qcom,mdss-dsi-bpp = <24>;
		qcom,mdss-dsi-panel-destination = "display_1";
		qcom,mdss-dsi-panel-timings = [94 20 14 00 46 4A 1A 24 18 03 04 00];
		qcom,mdss-dsi-on-command = [

			/* PASS WD */
			39 01 00 00 00 00 03 F0 5A 5A
			39 01 00 00 00 00 03 F1 5A 5A
			39 01 00 00 00 00 03 FC 5A 5A

			/* TDDI_CTL1 */
			39 01 00 00 00 00 02 71 0A

			/* TDDI Control3 */
			39 01 00 00 00 00 07 73 B0 64 00 01 68 00

			/* DISP_RSEL */
			39 01 00 00 00 00 05 B1 11 22 11 00

			/* Display Control 1  */
			39 01 00 00 00 00 11 B3 01 B9 07
									70 18 68 08
									08 07 80 00
									E5 00 E5 00
									E5

			/* DISP_TSC1  */
			39 01 00 00 00 00 58 BA 01 13 02
									13 02 13 02
									88 02 58 00
									84 08 43 07
									05 C1 00 94
									00 14 00 01
									26 01 10 C2
									89 50 2C 99
									46 46 00 01
									F1 01 01 28
									32 38 3F 48
									50 54 FF FF
									FF FF FF FF
									FF FF FF 2F
									48 64 98 BF
									DF FF FF FF
									FF FF FF FF
									FF FF 00 00
									08 00 00 00
									00 00 00 00
									00 00 00 00
									00 00 00 00

			/* Abnormal Control  */
			39 01 00 00 00 00 05 BB 21 68 00 00

			/* GOUTLR_CTL  */
			39 01 00 00 00 00 2D EC 00 08 00
									07 00 15 14
									02 0F 0D 0C
									0E 05 09 06
									02 02 00 00
									02 03 03 02
									08 02 07 02
									15 14 02 0E
									0C 0F 0D 04
									09 06 02 02
									00 00 02 03
									03

			/* GG_GSP  */
			39 01 00 00 00 00 48 ED 12 40 00
									15 11 00 0C
									13 40 00 15
									11 00 0C 00
									01 00 00 00
									00 10 00 41
									00 00 00 00
									10 00 01 00
									00 00 00 20
									00 21 00 00
									00 00 10 00
									40 01 72 61
									00 E0 20 41
									01 72 61 00
									C0 40 08 92
									4C 40 00 80
									28 00 3C 00
									00 00 00 00

			/* GG_GCK */
			39 01 00 00 00 00 25 EE 12 C4 80
									19 05 06 00
									00 68 12 C5
									80 19 05 06
									00 00 68 12
									C6 80 19 05
									06 00 00 6A
									12 C7 80 19
									05 06 00 00
									6A

			/* GG_CTRL */
			39 01 00 00 00 00 3C EF 00 00 00
									00 00 0C 40
									76 76 10 18
									09 80 00 08
									50 10 00 00
									48 00 00 00
									00 00 00 00
									00 00 00 11
									77 00 22 00
									00 00 00 00
									00 00 00 00
									00 00 00 00
									00 00 00 00
									00 00 00 00
									00 00 00 00

			/* Source Control */
			39 01 00 00 00 00 1B F2 48 22 33
									33 E3 4C 43
									80 01 00 00
									0D 8C 00 80
									00 A6 1E 08
									03 34 00 00
									00 00 00

			/* Power Control */
			39 01 00 00 00 00 1B F4 06 06 12
									17 8A D0 D0
									05 0A 15 BF
									55 59 3B 10
									55 15 26 FA
									00 00 00 00
									00 00 00

			/* ETC */
			39 01 00 00 00 00 32 F9 88 88 00
									C0 C0 04 7A
									00 0D C0 94
									0C 4B A0 1F
									A0 00 00 00
									00 00 0C 00
									10 00 00 00
									00 00 00 00
									0C 00 11 00
									00 00 00 00
									00 00 0C 00
									11 00 00 77
									00 00

			/* EDS TEST 0 */
			39 01 00 00 00 00 13 FE 02 00 01
									4C 00 00 00
									60 00 03 00
									00 00 00 00
									00 00 00

			/* EDS TEST 0 */
			39 01 00 00 00 00 10 C0 23 00 D8
									01 00 FF 00
									04 0F FF 70
									40 88 E6 A5

			/* CABC Control 2 */
			39 01 00 00 00 00 25 C1 BF 7F 7F
									25 66 7D 7F
									82 8A 8C 94
									A0 AE BA C2
									D4 DE F0 FA
									FF 88 96 A5
									B4 BE C8 CD
									D0 D3 D7 DF
									E6 EA F0 F5
									FF


			39 01 00 00 00 00 23 E8 01 09 12
									0C 12 19 18
									1A 21 25 26
									26 25 25 22
									30 32 01 09
									12 0C 12 19
									18 1A 21 25
									26 26 25 25
									22 30 32
									
			/* WRDISBV */
			15 01 00 00 00 00 02 51 FF
			
			/* WRCTRLD */
			15 01 00 00 00 00 02 53 24
			
			/* WRCABC */
			15 01 00 00 00 00 02 55 00

			/* Sleep Out */
			05 01 00 00 78 00 02 11 00 /* Wait 120 ms */
		];
		qcom,mdss-dsi-off-command = [

			/* Display Off and Wait 1 frame = 16.67 ms minimum */
			05 01 00 00 14 00 02 28 00

			/* Sleep in and Wait 5 frame =~ 90 ms minimum */
			05 01 00 00 5A 00 02 10 00
		];

		qcom,mdss-dsi-h-back-porch = <104>;
		qcom,mdss-dsi-v-back-porch = <10>;
		qcom,mdss-dsi-v-front-porch = <17>;
		qcom,mdss-dsi-v-pulse-width = <8>;
		qcom,mdss-dsi-h-front-porch = <100>;
		qcom,mdss-dsi-h-pulse-width = <24>;

		qcom,mdss-dsi-h-sync-skew = <0>;
		qcom,mdss-dsi-h-left-border = <0>;
		qcom,mdss-dsi-h-right-border = <0>;
		qcom,mdss-dsi-v-top-border = <0>;
		qcom,mdss-dsi-v-bottom-border = <0>;
		qcom,mdss-dsi-underflow-color = <0xff>;
		qcom,mdss-dsi-border-color = <0>;
		qcom,mdss-dsi-bl-pmic-control-type = "bl_ctrl_dcs";
		qcom,mdss-dsi-bl-min-level = <1>;
		qcom,mdss-dsi-bl-max-level = <256>;
		qcom,mdss-brightness-max-level = <256>;
		qcom,mdss-dsi-panel-type = "dsi_video_mode";
		qcom,mdss-dsi-h-sync-pulse = <0>;
		/*qcom,mdss-dsi-hfp-power-mode;
		qcom,mdss-dsi-bllp-eof-power-mode;
		qcom,mdss-dsi-bllp-power-mode;*/
		qcom,mdss-dsi-traffic-mode = "burst_mode";
		qcom,mdss-dsi-pixel-packing = "loose";
		qcom,mdss-dsi-virtual-channel-id = <0>;
		qcom,mdss-dsi-color-order = <0>;
		qcom,mdss-dsi-lane-0-state;
		qcom,mdss-dsi-lane-1-state;
		qcom,mdss-dsi-lane-2-state;
		qcom,mdss-dsi-lane-3-state;
		qcom,mdss-dsi-t-clk-post = <0x04>;
		qcom,mdss-dsi-t-clk-pre = <0x1D>;
		qcom,mdss-dsi-stream = <0>;
		qcom,mdss-dsi-mdp-trigger = "none";
		qcom,mdss-dsi-dma-trigger = "trigger_sw";
		qcom,mdss-dsi-panel-framerate = <60>;
		/*qcom,mdss-dsi-panel-clockrate = <600000000>;*/
		qcom,mdss-dsi-on-command-state = "dsi_lp_mode";
		qcom,mdss-dsi-off-command-state = "dsi_hs_mode";
		qcom,mdss-pan-physical-width-dimension = <62>;
		qcom,mdss-pan-physical-height-dimension = <111>;
		qcom,mdss-dsi-lp11-init;
		qcom,mdss-dsi-init-delay-us = <100>;
		qcom,mdss-dsi-rx-eot-ignore;
		qcom,mdss-dsi-tx-eot-append;

/*
 * ************************************************************************************************************************************
 *
 *
 *			Below  parameters are samsung dependent thigs
 *
 *
 * ************************************************************************************************************************************
 */
		samsung,panel-vendor = "BOE";
		samsung,tft-common-support;
		samsung,enter_hbm_lux = <20000>;

		/* To use device_resume & device_suspend for optimizing display on time */
		samsung,reduce_display_on_time;
		samsung,dsi_force_clock_lane_hs;
		qcom,mdss-dsi-force-clock-lane-hs;
		samsung,wait_after_reset_delay = <80>; /* Flash loading time */
		samsung,wait_after_sleep_out_delay = <107>; /* More than 6frame 16.6 * 6 = 99.6ms+7ms*/

		samsung,packet_size_tx_cmds_revA = [
			37 01 00 00 00 00 02 07 00
		];

		samsung,display_on_tx_cmds_revA = [

			/* Display On and Wait 1 frame = 16.67 ms minimum */
			05 01 00 00 14 00 02 29 00
			
			 /* TE on */
			15 01 00 00 00 00 02 35 00
		];

		samsung,display_off_tx_cmds_revA = [05 01 00 00 00 00 02 28 00];

		/*
		 * First parameters can be changed
		 * by function of samsung_nv_read()
		 * because of that means offset of
		 * read position
		 */
		samsung,reg_read_pos_tx_cmds_revA = [
			15 01 00 00 00 00 02 B0 00
		];
		samsung,manufacture_id0_rx_cmds_revA = [06 01 00 00 00 00 01 da 01 00];
		samsung,manufacture_id1_rx_cmds_revA = [06 01 00 00 00 00 01 db 01 00];
		samsung,manufacture_id2_rx_cmds_revA = [06 01 00 00 00 00 01 dc 01 00];

		samsung,mtp_read_sysfs_rx_cmds_revA = [06 01 00 00 00 00 01 00 00 00];

		samsung,tft_pwm_tx_cmds_revA=[
			39 01 00 00 00 00 02 51 FF
		];
		/*
		* ************************************************************************************************************************
		* Scaled level to index mappings
		* ************************************************************************************************************************
		*/
		samsung,candela_map_table_revA = <
		/*<idx>	  <from>  <till> <scaled_level> */
			0		0		0		0
			1		1		2		1
			2		3		3		2
			3		4		4		3
			4		5		5		4
			5		6		7		5
			6		8		8		6
			7		9		9		7
			8		10		10		8
			9		11		12		9
			10		13		13		10
			11		14		14		11
			12		15		15		12
			13		16		17		13
			14		18		18		14
			15		19		19		15
			16		20		20		16
			17		21		22		17
			18		23		23		18
			19		24		24		19
			20		25		25		20
			21		26		27		21
			22		28		28		22
			23		29		29		23
			24		30		30		24
			25		31		32		25
			26		33		33		26
			27		34		34		27
			28		35		35		28
			29		36		37		29
			30		38		38		30
			31		39		39		31
			32		40		40		32
			33		41		42		33
			34		43		43		34
			35		44		44		35
			36		45		45		36
			37		46		47		37
			38		48		48		38
			39		49		49		39
			40		50		50		40
			41		51		52		41
			42		53		53		42
			43		54		54		43
			44		55		56		44
			45		57		57		45
			46		58		58		46
			47		59		59		47
			48		60		61		48
			49		62		62		49
			50		63		63		50
			51		64		64		51
			52		65		66		52
			53		67		67		53
			54		68		68		54
			55		69		69		55
			56		70		71		56
			57		72		72		57
			58		73		73		58
			59		74		74		59
			60		75		76		60
			61		77		77		61
			62		78		78		62
			63		79		79		63
			64		80		81		64
			65		82		82		65
			66		83		83		66
			67		84		84		67
			68		85		86		68
			69		87		87		69
			70		88		88		70
			71		89		89		71
			72		90		91		72
			73		92		92		73
			74		93		93		74
			75		94		94		75
			76		95		96		76
			77		97		97		77
			78		98		98		78
			79		99		99		79
			80		100		101		80
			81		102		102		81
			82		103		103		82
			83		104		105		83
			84		106		106		84
			85		107		107		85
			86		108		108		86
			87		109		110		87
			88		111		111		88
			89		112		112		89
			90		113		113		90
			91		114		115		91
			92		116		116		92
			93		117		117		93
			94		118		118		94
			95		119		120		95
			96		121		121		96
			97		122		122		97
			98		123		123		98
			99		124		125		99
			100		126		126		100
			101		127		127		101
			102		128		128		102
			103		129		130		103
			104		131		131		104
			105		132		132		105
			106		133		133		106
			107		134		135		107
			108		136		136		108
			109		137		137		109
			110		138		138		110
			111		139		140		111
			112		141		141		112
			113		142		142		113
			114		143		143		114
			115		144		145		115
			116		146		146		116
			117		147		147		117
			118		148		148		118
			119		149		150		119
			120		151		151		120
			121		152		152		121
			122		153		153		122
			123		154		155		123
			124		156		156		124
			125		157		157		125
			126		158		159		126
			127		160		160		127
			128		161		161		128
			129		162		162		129
			130		163		164		130
			131		165		165		131
			132		166		166		132
			133		167		167		133
			134		168		169		134
			135		170		170		135
			136		171		171		136
			137		172		172		137
			138		173		174		138
			139		175		175		139
			140		176		176		140
			141		177		177		141
			142		178		179		142
			143		180		180		143
			144		181		181		144
			145		182		182		145
			146		183		184		146
			147		185		185		147
			148		186		186		148
			149		187		187		149
			150		188		189		150
			151		190		190		151
			152		191		191		152
			153		192		192		153
			154		193		194		154
			155		195		195		155
			156		196		196		156
			157		197		197		157
			158		198		199		158
			159		200		200		159
			160		201		201		160
			161		202		202		161
			162		203		204		162
			163		205		205		163
			164		206		206		164
			165		207		207		165
			166		208		209		166
			167		210		210		167
			168		211		211		168
			169		212		213		169
			170		214		214		170
			171		215		215		171
			172		216		216		172
			173		217		218		173
			174		219		219		174
			175		220		220		175
			176		221		221		176
			177		222		223		177
			178		224		224		178
			179		225		225		179
			180		226		226		180
			181		227		228		181
			182		229		229		182
			183		230		230		183
			184		231		231		184
			185		232		233		185
			186		234		234		186
			187		235		235		187
			188		236		236		188
			189		237		238		189
			190		239		239		190
			191		240		240		191
			192		241		241		192
			193		242		243		193
			194		244		244		194
			195		245		245		195
			196		246		246		196
			197		247		248		197
			198		249		249		198
			199		250		250		199
			200		251		251		200
			201		252		253		201
			202		254		254		202
			203		255		255		203
			204		256		256		255
		>;
	};
};
